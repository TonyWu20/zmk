## app/src/mouse/Kconfig
```kconfig
# Copyright (c) 2023 The ZMK Contributors
# SPDX-License-Identifier: MIT

config ZMK_MOUSE
    bool "Mouse Emulation"
    select INPUT
    select INPUT_THREAD_PRIORITY_OVERRIDE

config ZMK_POINTING_SMOOTH_SCROLLING
    bool "Smooth Scrolling"
    depends on ZMK_MOUSE
    default n
    help
      Enable smooth scrolling, with hosts that support HID Resolution Multipliers

config ZMK_POINTING_SMOOTH_SCROLL_DIVISOR
    int "Smooth Scrolling divisor"
    depends on ZMK_POINTING_SMOOTH_SCROLLING
    default 32
    range 1 255
    help
      Divides fine-grained wheel deltas before sending, with the remainder
      carried over between events. The HID descriptor tells the host the
      same value as physical maximum, so the host multiplies each received
      unit by it. Total travel is unchanged. The host renders the result as
      smooth sub-line motion. 32 matches the legacy CONFIG_PMW3610_SCROLL_TICK=32
      speed. Lower the value for a more sensitive trackball.
```
